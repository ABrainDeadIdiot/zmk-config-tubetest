## config/boards/shields/TubeTest/Kconfig.defconfig
```kconfig
if SHIELD_TUBETEST
config ZMK_KEYBOARD_NAME
    default "TubeTest"
config SPI
    default y
endif
```

## config/boards/shields/TubeTest/kconfig.defconfig
```kconfig
if SHIELD_TubeTest
            
config ZMK_KEYBOARD_NAME
    default "split"

config SPI
    default y

endif
```

## config/boards/shields/split/kconfig.defconfig
```kconfig
if SHIELD_TubeTest
            
config ZMK_KEYBOARD_NAME
    default "split"

endif
```
